/dts-v1/;

#include <ti/tm4c123.dtsi>

/ {
	model = "TI TM4C123GXL Launchpad";
	compatible = "ti,ti_tm4c123gxl_launchpad","ti,tm4c123gh6pm",
						"ti,tm4c123";
	aliases {
		uart_0 = &uart0;
	};

	chosen {
		zephyr,sram = &sram0;
		zephyr,flash = &flash0;
		zephyr,console = &uart0;
	};
};

&uart0 {
	status = "ok";
	current-speed = <115200>;
};