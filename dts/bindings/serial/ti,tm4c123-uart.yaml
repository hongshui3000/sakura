## dts/bindings/serial/ti,tm4c123-uart.yaml
```yaml
---
title: TI TM4C123 UART
id: ti,tm4c123-uart
version: 0.1

description: >
    This binding gives a base representation of the TI TM4C123 UART

inherits:
  - !include uart.yaml

properties:
  - compatible:
      type: string
      category: required
      description: compatible strings
      constraint: "ti,tm4c123-uart"

  - reg:
      type: array
      description: mmio register space
      generation: define
      category: required

  - interrupts:
      type: array
      category: required
      description: required interrupts
      generation: define
...
```

## dts/bindings/spi/ti,tm4c123-spi.yaml
```yaml
#
# Copyright (c) 2018, hackin, zhao
#
# SPDX-License-Identifier: Apache-2.0
#
---
title: TM4C123 SPI
id: st,tm4c123-spi
version: 0.1

description: >
    This binding gives a base representation of the TM4C123 SPI controller

inherits:
    !include spi.yaml

properties:
    compatible:
      type: string
      category: required
      description: compatible strings
      constraint: "st,tm4c123-spi"

    reg:
      type: array
      description: mmio register space
      generation: define
      category: required

    interrupts:
      type: array
      category: required
      description: required interrupts
      generation: define

    interrupt-names:
      type: stringlist
      category: optional
      description: readable string describing the interrupts
      generation: define

...
```

## ext/hal/ti/ek-tm4c12x/Kconfig
```kconfig
# Kconfig - TM4C12X SDK HAL configuration

config HAS_TM4C12X_SDK
	bool

menuconfig HAS_TM4C12X_SDK
	bool "TI TM4C12X SDK support"
	default n
	depends on HAS_CMSIS
	help
	Build required peripheral driverlib files from the TM4C12X SDK
```

## ext/hal/ti/tivaware/Kconfig
```kconfig
# Kconfig - TIVAWARE SDK HAL configuration

config HAS_TIVAWARE_SDK
	bool

menuconfig HAS_TIVAWARE_SDK
	bool "TI TIVAWARE SDK support"
	default n
	depends on HAS_CMSIS
	help
	Build required peripheral driverlib files from the TIVAWARE SDK
```

## ext/qpc/Kconfig
```kconfig
#
# Copyright (c) 2018 hackin zhao
#
# SPDX-License-Identifier: Apache-2.0
#

menu "Qpc state machine"

config QPC
	bool
	prompt "TinyCrypt Support"
	default n
	help
	  This option enables the TinyCrypt cryptography library.

config QPC_QF
	bool
	prompt "PRNG in counter mode"
	depends on QPC
	default n
	help
	  This option enables support for the pseudo-random number
	  generator in counter mode.

config QPC_QK
	bool
	prompt "SHA-256 Hash function support"
	depends on QPC
	default n
	help
	  This option enables support for SHA-256
	  hash function primitive.

config QPC_QS
	bool
	prompt "HMAC (via SHA256) message auth support"
	depends on QPC
	default n
	help
	  This option enables support for HMAC using SHA-256
	  message authentication code.

config QPC_QV
	bool
	prompt "PRNG (via HMAC-SHA256) support"
	depends on QPC
	default n
	help
	  This option enables support for pseudo-random number
	  generator.

config QPC_QV
	bool
	prompt "PRNG (via HMAC-SHA256) support"
	depends on QPC
	default n
	help
	  This option enables support for pseudo-random number
	  generator.

endmenu
```

## framework/Kconfig
```kconfig
# Kconfig - useful framework source code configuration options

#
# Copyright (c) 2018 hackin zhao.
#
# SPDX-License-Identifier: Apache-2.0
#

menu "Framework Sources"

source "framework/qpc/Kconfig"

endmenu
```

## framework/qpc/Kconfig
```kconfig
#
# Copyright (c) 2018 hackin zhao
#
# SPDX-License-Identifier: Apache-2.0
#

menu "Qpc state machine"

config QPC
	bool
	prompt "Qpc state machine Support"
	default n
	help
	  This option enables the Qpc state machine framework.

config QPC_QF
	bool
	prompt "QF mode"
	depends on QPC
	default n
	help
	  This option enables support for the pseudo-random number
	  generator in counter mode.

config QPC_QK
	bool
	prompt "SHA-256 Hash function support"
	depends on QPC
	default n
	help
	  This option enables support for SHA-256
	  hash function primitive.

config QPC_QS
	bool
	prompt "HMAC (via SHA256) message auth support"
	depends on QPC
	default n
	help
	  This option enables support for HMAC using SHA-256
	  message authentication code.

config QPC_QV
	bool
	prompt "PRNG (via HMAC-SHA256) support"
	depends on QPC
	default n
	help
	  This option enables support for pseudo-random number
	  generator.

config QPC_QV
	bool
	prompt "PRNG (via HMAC-SHA256) support"
	depends on QPC
	default n
	help
	  This option enables support for pseudo-random number
	  generator.

endmenu
```

## tests/drivers/spi/spi_loopback/boards/ti_tm4c123gxl_launchpad.conf
```kconfig
CONFIG_SPI_LOOPBACK_DRV_NAME="SPI_0"
CONFIG_SPI_TM4C123=y
CONFIG_SPI_0=y
CONFIG_SPI=y
CONFIG_SPI_0_IRQ_PRI=1
CONFIG_HAS_DTS=y
CONFIG_HAS_DTS_SPI=y
```
