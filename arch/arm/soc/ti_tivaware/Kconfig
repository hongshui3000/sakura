## arch/arm/soc/ti_tivaware/Kconfig
```kconfig
# Kconfig - Texas Instruments Tivaware Family
#

config SOC_FAMILY_TIVAWARE
	bool
	# omit prompt to signify a "hidden" option
	default n

if SOC_FAMILY_TIVAWARE
config SOC_FAMILY
	string
	default "ti_tivaware"
endif

source "arch/arm/soc/ti_tivaware/*/Kconfig.soc"
```

## arch/arm/soc/ti_tivaware/Kconfig.soc
```kconfig
# Kconfig - Texas Instruments Tivaware Family
#

source "arch/arm/soc/ti_tivaware/*/Kconfig.series"
```

## arch/arm/soc/ti_tivaware/tm4c123/Kconfig.defconfig.series
```kconfig
# Kconfig.defconfig.series - TI tivaware Family
#

if SOC_SERIES_TM4C123

source "arch/arm/soc/ti_tivaware/tm4c123/Kconfig.defconfig.tm4c123*"

config SOC_SERIES
	default "tm4c123"

endif # SOC_SERIES_TM4C123
```

## arch/arm/soc/ti_tivaware/tm4c123/Kconfig.defconfig.tm4c123gh6pm
```kconfig
# Kconfig.defconfig.tm4c123gh6pm - TI tm4c12x TM4C123gxl SoC
#

if SOC_TM4C123GH6PM

config SOC
	string
	default "tm4c123gh6pm"

config NUM_IRQS
	int
	# must be >= the highest interrupt number used
	# This includes the NWP interrupt
	default 154

config SYS_CLOCK_HW_CYCLES_PER_SEC
	int
	default 80000000

# if GPIO
#
# config GPIO_TM4C123GH6PM
# 	def_bool y
#
# config GPIO_GPIO_TM4C123GXL_A0
# 	default n
#
# config GPIO_GPIO_TM4C123GXL_A1
# 	default y
#
# config GPIO_GPIO_TM4C123GXL_A2
# 	default y
#
# config GPIO_GPIO_TM4C123GXL_A3
# 	default n
#
# endif # GPIO

endif # SOC_TM4C123GH6PM
```

## arch/arm/soc/ti_tivaware/tm4c123/Kconfig.series
```kconfig
# Kconfig.series - TI tivaware TM4C123 series
#

config  SOC_SERIES_TM4C123
	bool "TI tivaware Family"
	select CPU_CORTEX_M
	select CPU_CORTEX_M4
	select SOC_FAMILY_TIVAWARE
	select CPU_HAS_FPU
	select CPU_HAS_SYSTICK
	help
	  Enable support for TI tivaware TM4C123 series
```

## arch/arm/soc/ti_tivaware/tm4c123/Kconfig.soc
```kconfig
# Kconfig.soc - Texas Instruments TM4C123
#

choice
prompt "TI tivaware TM4C123 MCU Selection"
depends on SOC_SERIES_TM4C123

config SOC_TM4C123GH6PM
	bool "TM4C123GH6PM"
	select HAS_TIVAWARE_SDK

endchoice
```

## arch/arm/soc/ti_tm4c/Kconfig
```kconfig
# Kconfig - Texas Instruments SimpleLink Family
#

config SOC_FAMILY_TI_TM4C12XX
	bool
	# omit prompt to signify a "hidden" option
	default n

if SOC_FAMILY_TI_TM4C12XX
config SOC_FAMILY
	string
	default ti_tm4c
endif

source "arch/arm/soc/ti_tm4c/*/Kconfig.soc"
```

## arch/arm/soc/ti_tm4c/Kconfig.soc
```kconfig
# Kconfig - Texas Instruments SimpleLink Family
#

source "arch/arm/soc/ti_tm4c/*/Kconfig.series"
```

## arch/arm/soc/ti_tm4c/tm4c12x/Kconfig.defconfig.series
```kconfig
# Kconfig.defconfig.series - TI tm4c Family
#

if SOC_SERIES_TM4C12X

source "arch/arm/soc/ti_tm4c/tm4c123x/Kconfig.defconfig.tm4c12*"

config SOC_SERIES
	default tm4c12x

endif # SOC_SERIES_TM4C12X
```

## arch/arm/soc/ti_tm4c/tm4c12x/Kconfig.series
```kconfig
# Kconfig.series - TI tm4c TM4C12X
#

config  SOC_SERIES_TM4C12X
	bool "TI tm4c Family"
	select CPU_CORTEX_M
	select CPU_CORTEX_M4
	select SOC_FAMILY_TI_TM4C
	select CPU_HAS_SYSTICK
	help
	  Enable support for TI tm4c TM4C12X
```

## arch/arm/soc/ti_tm4c/tm4c12x/Kconfig.soc
```kconfig
# Kconfig.soc - Texas Instruments CC32XX
#

choice
prompt "TI tm4c MCU Selection"
depends on SOC_SERIES_TM4C12X

config SOC_TM4C123GXL
	bool "TM4C123GXL"
	select HAS_TM4C123SDK

endchoice


if SOC_TM4C123GXL

config TM4C123GXL_DEBUG
	bool "Prepend debug header, disabling flash verification"
	depends on XIP
	default y if XIP
	default n if !XIP

endif # SOC_TM4C123GXL
```

## arch/arm/soc/ti_tm4c12x/Kconfig
```kconfig
# Kconfig - Texas Instruments SimpleLink Family
#

config SOC_FAMILY_TM4C12X
	bool
	# omit prompt to signify a "hidden" option
	default n

if SOC_FAMILY_TM4C12X
config SOC_FAMILY
	string
	default ti_tm4c12x
endif

source "arch/arm/soc/ti_tm4c12x/*/Kconfig.soc"
```

## arch/arm/soc/ti_tm4c12x/tm4c123/Kconfig.series
```kconfig
# Kconfig.series - TI tm4c TM4C123
#

config  SOC_SERIES_TM4C123
	bool "TI tm4c123 Family"
	select CPU_CORTEX_M
	select CPU_CORTEX_M4
	select SOC_FAMILY_TM4C12X
	select CPU_HAS_FPU
	select CPU_HAS_SYSTICK
	help
	  Enable support for TI tm4c12x TM4C123
```

## arch/arm/soc/ti_tm4c12x/tm4c123/Kconfig.soc
```kconfig
# Kconfig.soc - Texas Instruments TM4C123
#

choice
prompt "TI tm4c12x MCU Selection"
depends on SOC_SERIES_TM4C123

config SOC_TM4C123GH6PM
	bool "TM4C123GH6PM"
	select HAS_TM4C12X_SDK

endchoice
```

## boards/arm/ti_tm4c123gxl_lauchpad/Kconfig.board
```kconfig
# Kconfig - TI TM4C123GX LaunchXL Board
#

config  BOARD_TI_TM4C123GXL_LAUNCHPAD
	bool "TI TM4C123GXL LAUNCHPAD"
	depends on SOC_TM4C123GH6PM
```

## boards/arm/ti_tm4c123gxl_launchpad/Kconfig.board
```kconfig
# Kconfig - TI TM4C123GX LaunchPad Board
#

config  BOARD_TI_TM4C123GXL_LAUNCHPAD
	bool "TI TM4C123GXL LAUNCHPAD"
	depends on SOC_TM4C123GH6PM
```

## boards/arm/ti_tm4c123gxl_launchpad/Kconfig.defconfig
```kconfig
# Kconfig - TI TM4C123GXL LaunchPad board configuration
#

if BOARD_TI_TM4C123GXL_LAUNCHPAD

config BOARD
	default ti_tm4c123gxl_launchpad

endif # BOARD_TI_TM4C123GXL_LAUNCHPAD
```

## boards/arm/ti_tm4c123gxl_launchpad/ti_tm4c123gxl_launchpad_defconfig
```kconfig
CONFIG_ARM=y
CONFIG_BOARD_TI_TM4C123GXL_LAUNCHPAD=y
CONFIG_SOC_FAMILY_TIVAWARE=y
CONFIG_SOC_SERIES_TM4C123=y
CONFIG_SOC_TM4C123GH6PM=y
CONFIG_CORTEX_M_SYSTICK=y
CONFIG_FLASH=y

CONFIG_PRINTK=y

#enable GPIO driver
CONFIG_GPIO=y
CONFIG_GPIO_TM4C123=y
CONFIG_GPIO_TM4C123_F0=y
CONFIG_GPIO_TM4C123_F1=y
CONFIG_GPIO_TM4C123_F2=y
CONFIG_GPIO_TM4C123_F3=y
CONFIG_GPIO_TM4C123_F4=y

# enable uart driver
CONFIG_SERIAL=y
CONFIG_SERIAL_HAS_DRIVER=y
CONFIG_UART_TM4C123=y
#CONFIG_UART_INTERRUPT_DRIVEN=y

# enable console
CONFIG_CONSOLE=y
CONFIG_UART_CONSOLE=y

# Enable TI TIVAWARE SDK
CONFIG_HAS_TIVAWARE_SDK=y
```

## drivers/gpio/Kconfig.tm4c123
```kconfig
# Kconfig.tm4c123- TM4C123 GPIO configuration options
#

menuconfig GPIO_TM4C123
	bool "TI TM4C123 GPIO driver"
	depends on GPIO && SOC_FAMILY_TIVAWARE
	default n
	help
	  Enable the GPIO driver on TI TivaWare TM4C123 boards

if GPIO_TM4C123

config GPIO_TM4C123_F1
	bool "GPIO block F1"
	depends on GPIO_TM4C123
	default n
	help
	  Include support for the GPIO port F1.

config GPIO_TM4C123_F1_NAME
	string "Driver name"
	depends on GPIO_TM4C123_F1
	default "GPIO_F1"

config GPIO_TM4C123_F1_IRQ_PRI
	int "GPIO F1 interrupt priority"
	depends on GPIO_TM4C123_F1
	range 0 5
	default 1
	help
	  TM4C123 GPIO F1 IRQ priority.

config GPIO_TM4C123_F2
	bool "GPIO block F2"
	depends on GPIO_TM4C123
	default n
	help
	  Include support for the GPIO port F2.

config GPIO_TM4C123_F2_NAME
	string "Driver name"
	depends on GPIO_TM4C123_F2
	default "GPIO_F2"

config GPIO_TM4C123_F2_IRQ_PRI
	int "GPIO F2 interrupt priority"
	depends on GPIO_TM4C123_F2
	range 0 5
	default 1
	help
	  TM4C123 GPIO F2 IRQ priority.

config GPIO_TM4C123_F3
	bool "GPIO block F3"
	depends on GPIO_TM4C123
	default n
	help
	  Include support for the GPIO port F3.

config GPIO_TM4C123_F3_NAME
	string "Driver name"
	depends on GPIO_TM4C123_F3
	default "GPIO_F3"

config GPIO_TM4C123_F3_IRQ_PRI
	int "GPIO F3 interrupt priority"
	depends on GPIO_TM4C123_F3
	range 0 5
	default 1
	help
	  TM4C123 GPIO F3 IRQ priority.

config GPIO_TM4C123_F0
	bool "GPIO block F0"
	depends on GPIO_TM4C123
	default n
	help
	  Include support for the GPIO port F0.

config GPIO_TM4C123_F0_NAME
	string "Driver name"
	depends on GPIO_TM4C123_F0
	default "GPIO_F0"

config GPIO_TM4C123_F0_IRQ_PRI
	int "GPIO F0 interrupt priority"
	depends on GPIO_TM4C123_F0
	range 0 5
	default 1
	help
	  TM4C123 GPIO F0 IRQ priority.

config GPIO_TM4C123_F4
	bool "GPIO block F4"
	depends on GPIO_TM4C123
	default n
	help
	  Include support for the GPIO port F4.

config GPIO_TM4C123_F4_NAME
	string "Driver name"
	depends on GPIO_TM4C123_F4
	default "GPIO_F4"

config GPIO_TM4C123_F4_IRQ_PRI
	int "GPIO F4 interrupt priority"
	depends on GPIO_TM4C123_F4
	range 0 5
	default 1
	help
	  TM4C123 GPIO F4 IRQ priority.

endif # GPIO_TM4C123
```

## drivers/ieee802154/Kconfig.dw1000
```kconfig
# Kconfig.dw1000 - DECAWAVE DW1000 configuration options
#

menuconfig IEEE802154_DW1000
	bool "DECAWAVE DW1000 Driver support"
	depends on NETWORKING
	select NET_L2_IEEE802154_SUB_GHZ
	default n

if IEEE802154_DW1000

config IEEE802154_DW1000_DRV_NAME
	string "DECAWAVE DW1000 Driver's name"
	default "dw1000"
	help
	  This option sets the driver name

config IEEE802154_DW1000_GPIO_ISR_DRV_NAME
	string "the interrupt pin driver's name to use to access DW1000"
	default ""
	help
	  This option is mandatory to set which gpio pin to use in order
	  to receive dw1000 interrupt.

config IEEE802154_DW1000_GPIO_RST_DRV_NAME
	string "the reset pin driver's name to use to access DW1000"
	default ""
	help
	  This option is mandatory to set which gpio pin to use in order
	  to reset the dw1000 device.

config IEEE802154_DW1000_GPIO_WAKEUP_DRV_NAME
	string "the wakeup pin driver's name to use to access DW1000"
	default ""
	help
	  This option is mandatory to set which gpio pin to use in order
	  to wakeup dw1000 device.

config IEEE802154_DW1000_GPIO_EXTON_DRV_NAME
	string "the exton pin driver's name to use to access DW1000"
	default ""
	help
	  This option is mandatory to set which gpio pin to use in order
	  to receive dw1000 interrupt.

config IEEE802154_DW1000_GPIO_GPIO_5_DRV_NAME
	string "the spi mode set pin driver's name to use to access DW1000"
	default ""
	help
	  This option is mandatory to set which gpio pin to use in order
	  to set the dw1000 SPI mode(POL).

config IEEE802154_DW1000_GPIO_GPIO_6_DRV_NAME
	string "the spi mode set pin driver's name to use to access DW1000"
	default ""
	help
	  This option is mandatory to set which gpio pin to use in order
	  to set the dw1000 SPI mode(PHA).

config IEEE802154_DW1000_SPI_DRV_NAME
	string "SPI driver's name to use to access DW1000"
	default ""
	help
	  This option is mandatory to set which SPI controller to use in order
	  to actually control the DW1000 chip.

config IEEE802154_DW1000_SPI_FREQ
	int "SPI system frequency"
	default 0
	help
	  This option sets the SPI controller's frequency. Beware this value
	  depends on the SPI controller being used and also on the system
	  clock.

config IEEE802154_DW1000_SPI_SLAVE
	int "SPI slave linked to DW1000"
	default 0
	help
	  This option sets the SPI slave number SPI controller has to switch
	  to when dealing with DW1000 chip.

config IEEE802154_DW1000_GPIO_SPI_CS
	bool "Manage SPI CS through a GPIO pin"
	default n
	help
	  This option is useful if one needs to manage SPI CS through a GPIO
	  pin to by-pass the SPI controller's CS logic.

config IEEE802154_DW1000_GPIO_SPI_CS_DRV_NAME
	string "GPIO driver's name to use to drive SPI CS through"
	default ""
	depends on IEEE802154_DW1000_GPIO_SPI_CS
	help
	  This option is mandatory to set which GPIO controller to use in order
	  to actually emulate the SPI CS.

config IEEE802154_DW1000_GPIO_SPI_CS_PIN
	int "GPIO PIN to use to drive SPI CS through"
	default 0
	depends on IEEE802154_DW1000_GPIO_SPI_CS
	help
	  This option is mandatory to set which GPIO pin to use in order
	  to actually emulate the SPI CS.

config IEEE802154_DW1000_RX_STACK_SIZE
	int "Driver's internal RX thread stack size"
	default 800
	help
	  This option sets the driver's stack size for its internal RX thread.
	  The default value should be sufficient, but in case it proves to be
	  a too little one, this option makes it easy to play with the size.

config IEEE802154_DW1000_INIT_PRIO
	int "DW1000 initialization priority"
	default 80
	help
	  Set the initialization priority number. Do not mess with it unless
	  you know what you are doing. Beware dw1000 requires gpio and spi to
	  be ready first (and sometime gpio should be the very first as spi
	  might need it too). And of course it has to start before the net stack.

config IEEE802154_DW1000_RANDOM_MAC
	bool "Random MAC address"
	default y
	help
	  Generate a random MAC address dynamically.

if ! IEEE802154_DW1000_RANDOM_MAC

config IEEE802154_DW1000_MAC4
	hex "MAC Address Byte 4"
	default 0
	range 0 ff
	help
	  This is the byte 4 of the MAC address.

config IEEE802154_DW1000_MAC5
	hex "MAC Address Byte 5"
	default 0
	range 0 ff
	help
	  This is the byte 5 of the MAC address.

config IEEE802154_DW1000_MAC6
	hex "MAC Address Byte 6"
	default 0
	range 0 ff
	help
	  This is the byte 6 of the MAC address.

config IEEE802154_DW1000_MAC7
	hex "MAC Address Byte 7"
	default 0
	range 0 ff
	help
	  This is the byte 7 of the MAC address.

endif # IEEE802154_DW1000_RANDOM_MAC
```

## drivers/serial/Kconfig.tm4c123
```kconfig
menuconfig UART_TM4C123
	depends on SOC_SERIES_TM4C123
	bool "TM4C123 UART driver"
	default n
	select SERIAL_HAS_DRIVER
	select SERIAL_SUPPORT_INTERRUPT
	depends on SOC_FAMILY_TIVAWARE
	help
	  This option enables the TM4C123 UART driver, for UART_0.
```

## drivers/spi/Kconfig.tm4c123
```kconfig
# Kconfig - TM4C123 SPI driver configuration options

#
# Copyright (c) 2018 hackin zhao
#
# SPDX-License-Identifier: Apache-2.0
#

menuconfig SPI_TM4C123
	bool "TM4C123 MCU SPI controller driver"
	depends on SPI && SOC_SERIES_TM4C123
	select SERIAL_HAS_DRIVER
    depends on SOC_FAMILY_TIVAWARE
	default n
	help
	  Enable SPI support on the TM4C123 family of processors.

if SPI_TM4C123

config SPI_TM4C123_INTERRUPT
	bool "TM4C123 MCU SPI Interrupt Support"
	default n
	help
	  Enable Interrupt support for the SPI Driver of TM4C123 family.

endif # SPI_TM4C123
```
